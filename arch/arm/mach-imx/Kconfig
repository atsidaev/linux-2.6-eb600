## arch/arm/mach-imx/Kconfig
```kconfig
menu "IMX Implementations"
	depends on ARCH_IMX

config ARCH_MX1ADS
	bool "mx1ads"
	depends on ARCH_IMX
	select ISA
	help
	  Say Y here if you are using the Motorola MX1ADS board

config MACH_SONY_PRS505
        bool "Sony PRS-505 book reader"
        depends on ARCH_IMX
	help
	  Say Y here if you are using the Sony PRS-505 book reader.

config SONY_PRS505_DISPLAY
        tristate "Sony PRS-505 book reader display support"
        depends on MACH_SONY_PRS505
	help
	  Say Y here if you are using the Sony PRS-505 book reader and want
	  to have display working. Note that this only glue between metronomefb
	  and imxfb drivers. They also must be enabled.

endmenu
```
